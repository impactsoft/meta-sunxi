## conf/machine/orange-pi-zero2w.conf
```bitbake
#@TYPE: Machine
#@NAME: orange-pi-zero-2w
#@DESCRIPTION: Machine configuration for the orange-pi-zero-2w, based on Allwinner H618 CPU

require conf/machine/include/sun50i-h616.inc

# Install expansion board overlay (0 = off, 1 = on)
INSTALL_ORANGE_PI_ZERO2W_EXPANSION ??= "0"

KERNEL_DEVICETREE = "allwinner/sun50i-h618-orangepi-zero2w.dtb allwinner/sun50i-h618-orangepi-zero2w-expansion.dtbo"

IMAGE_BOOT_FILES = " \
  ${KERNEL_IMAGETYPE} \
  boot.scr \
  sun50i-h618-orangepi-zero2w.dtb \
  ${@'sun50i-h618-orangepi-zero2w-expansion.dtbo;overlays/sun50i-h618-orangepi-zero2w-expansion.dtso' if d.getVar('INSTALL_ORANGE_PI_ZERO2W_EXPANSION') == '1' else ''} \
"

UBOOT_MACHINE = "orangepi_zero2w_defconfig"
SPL_BINARY = "u-boot-sunxi-with-spl.bin"

SUNXI_BOOT_SPACE = "50"

# No X11 and no audio by default (but is setup for audio/expansion audio)
MACHINE_FEATURES:remove = "alsa x11"
MACHINE_FEATURES:append = "bluetooth wifi"

MACHINE_EXTRA_RRECOMMENDS = "uwe5622-firmware"

# Load modules for wifi & bt
# Note: for wifi a custom hci attach userspace sofware is needed that is not included in the layer
KERNEL_MODULE_AUTOLOAD += " sprdwl_ng sprdbt_tty "
```
